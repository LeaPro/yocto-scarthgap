/**
 * @cliArgs --device "AM62x" --part "AM6234-G" --package "ALW"
 * @versions {"tool":"1.25.0+4268"}
 */

/**
 * Import the modules used in this configuration.
 */
const powerDomains = scripting.addModule("/ti/corePinmux/powerDomains");

/**
 * Write custom configuration values to the imported modules.
 */
powerDomains.VDDSHV0                      = "3.3 V";
powerDomains.VDDSHV1                      = "3.3 V";
powerDomains.VDDSHV3                      = "3.3 V";
powerDomains["VDDS_DDR-VDDS_DDR_C"]       = "1.2 V";
powerDomains.VDDSHV5                      = "3.3 V";
powerDomains.VDDSHV6                      = "3.3 V";
powerDomains.VDDSHV_CANUART               = "3.3 V";
powerDomains.VDDSHV2                      = "3.3 V";
powerDomains.VDDSHV_MCU                   = "3.3 V";
powerDomains["VDDA_1P8_USB-VDDA_3P3_USB"] = "3.3 V";

/**
 * These are the peripherals and settings in this configuration
 */
const DDRSS1                     = scripting.addPeripheral("DDRSS");
DDRSS1.$name                     = "MyDDRSS1";
const GPIO1                      = scripting.addPeripheral("GPIO");
GPIO1["0"].$assign               = "OSPI0_CLK";
GPIO1["0"].$used                 = true;
GPIO1["1"].$assign               = "OSPI0_LBCLKO";
GPIO1["1"].$used                 = true;
GPIO1["2"].$assign               = "OSPI0_DQS";
GPIO1["2"].$used                 = true;
GPIO1["3"].$assign               = "OSPI0_D0";
GPIO1["3"].$used                 = true;
GPIO1["4"].$assign               = "OSPI0_D1";
GPIO1["4"].$used                 = true;
GPIO1["5"].$assign               = "OSPI0_D2";
GPIO1["5"].$used                 = true;
GPIO1["6"].$assign               = "OSPI0_D3";
GPIO1["6"].$used                 = true;
GPIO1["7"].$used                 = false;
GPIO1["8"].$used                 = false;
GPIO1["9"].$used                 = false;
GPIO1["10"].$used                = false;
GPIO1["11"].$assign              = "OSPI0_CSn0";
GPIO1["11"].$used                = true;
GPIO1["12"].$assign              = "OSPI0_CSn1";
GPIO1["12"].$used                = true;
GPIO1["13"].$used                = false;
GPIO1["14"].$assign              = "OSPI0_CSn3";
GPIO1["14"].$used                = true;
GPIO1["15"].$assign              = "GPMC0_AD0";
GPIO1["15"].$used                = true;
GPIO1["16"].$used                = false;
GPIO1["17"].$used                = false;
GPIO1["18"].$used                = false;
GPIO1["19"].$used                = false;
GPIO1["20"].$used                = false;
GPIO1["21"].$used                = false;
GPIO1["22"].$used                = false;
GPIO1["23"].$assign              = "GPMC0_AD8";
GPIO1["23"].$used                = true;
GPIO1["24"].$assign              = "GPMC0_AD9";
GPIO1["24"].$used                = true;
GPIO1["25"].$assign              = "GPMC0_AD10";
GPIO1["25"].$used                = true;
GPIO1["26"].$assign              = "GPMC0_AD11";
GPIO1["26"].$used                = true;
GPIO1["27"].$assign              = "GPMC0_AD12";
GPIO1["27"].$used                = true;
GPIO1["28"].$assign              = "GPMC0_AD13";
GPIO1["28"].$used                = true;
GPIO1["29"].$assign              = "GPMC0_AD14";
GPIO1["29"].$used                = true;
GPIO1["30"].$assign              = "GPMC0_AD15";
GPIO1["30"].$used                = true;
GPIO1["31"].$assign              = "GPMC0_CLK";
GPIO1["31"].$used                = true;
GPIO1["32"].$assign              = "GPMC0_ADVn_ALE";
GPIO1["32"].$used                = true;
GPIO1["33"].$assign              = "GPMC0_OEn_REn";
GPIO1["33"].$used                = true;
GPIO1["34"].$assign              = "GPMC0_WEn";
GPIO1["34"].$used                = true;
GPIO1["35"].$assign              = "GPMC0_BE0n_CLE";
GPIO1["35"].$used                = true;
GPIO1["36"].$assign              = "GPMC0_BE1n";
GPIO1["36"].$used                = true;
GPIO1["37"].$assign              = "GPMC0_WAIT0";
GPIO1["37"].$used                = true;
GPIO1["38"].$assign              = "GPMC0_WAIT1";
GPIO1["38"].$used                = true;
GPIO1["39"].$assign              = "GPMC0_WPn";
GPIO1["39"].$used                = true;
GPIO1["40"].$assign              = "GPMC0_DIR";
GPIO1["40"].$used                = true;
GPIO1["41"].$assign              = "GPMC0_CSn0";
GPIO1["41"].$used                = true;
GPIO1["42"].$assign              = "GPMC0_CSn1";
GPIO1["42"].$used                = true;
GPIO1["43"].$assign              = "GPMC0_CSn2";
GPIO1["43"].$used                = true;
GPIO1["44"].$assign              = "GPMC0_CSn3";
GPIO1["44"].$used                = true;
GPIO1["45"].$used                = false;
GPIO1["46"].$used                = false;
GPIO1["47"].$assign              = "VOUT0_DATA2";
GPIO1["47"].$used                = true;
GPIO1["48"].$assign              = "VOUT0_DATA3";
GPIO1["48"].$used                = true;
GPIO1["49"].$used                = false;
GPIO1["50"].$used                = false;
GPIO1["51"].$assign              = "VOUT0_DATA6";
GPIO1["51"].$used                = true;
GPIO1["52"].$assign              = "VOUT0_DATA7";
GPIO1["52"].$used                = true;
GPIO1["53"].$assign              = "VOUT0_DATA8";
GPIO1["53"].$used                = true;
GPIO1["54"].$assign              = "VOUT0_DATA9";
GPIO1["54"].$used                = true;
GPIO1["55"].$assign              = "VOUT0_DATA10";
GPIO1["55"].$used                = true;
GPIO1["56"].$assign              = "VOUT0_DATA11";
GPIO1["56"].$used                = true;
GPIO1["57"].$assign              = "VOUT0_DATA12";
GPIO1["57"].$used                = true;
GPIO1["58"].$assign              = "VOUT0_DATA13";
GPIO1["58"].$used                = true;
GPIO1["59"].$assign              = "VOUT0_DATA14";
GPIO1["59"].$used                = true;
GPIO1["60"].$assign              = "VOUT0_DATA15";
GPIO1["60"].$used                = true;
GPIO1["61"].$assign              = "VOUT0_HSYNC";
GPIO1["61"].$used                = true;
GPIO1["62"].$assign              = "VOUT0_DE";
GPIO1["62"].$used                = true;
GPIO1["63"].$used                = false;
GPIO1["64"].$used                = false;
GPIO1["65"].$used                = false;
GPIO1["66"].$used                = false;
GPIO1["67"].$used                = false;
GPIO1["68"].$used                = false;
GPIO1["69"].$used                = false;
GPIO1["70"].$used                = false;
GPIO1["71"].$assign              = "MMC2_SDCD";
GPIO1["71"].$used                = false;
GPIO1["72"].$assign              = "MMC2_SDWP";
GPIO1["72"].$used                = true;
GPIO1["73"].$used                = false;
GPIO1["74"].$used                = false;
GPIO1["75"].$used                = false;
GPIO1["76"].$used                = false;
GPIO1["77"].$used                = false;
GPIO1["78"].$used                = false;
GPIO1["79"].$used                = false;
GPIO1["80"].$used                = false;
GPIO1["81"].$used                = false;
GPIO1["82"].$used                = false;
GPIO1["83"].$used                = false;
GPIO1["84"].$used                = false;
GPIO1["85"].$used                = false;
GPIO1["86"].$used                = false;
GPIO1["87"].$used                = false;
GPIO1["88"].$used                = false;
GPIO1["89"].$used                = false;
GPIO1["90"].$used                = false;
GPIO1["91"].$used                = false;
GPIO1.$name                      = "MyGPIO1";
GPIO1.$assignVoltage             = "3.3 V";
const GPIO2                      = scripting.addPeripheral("GPIO");
GPIO2["0"].$used                 = false;
GPIO2["1"].$used                 = false;
GPIO2["2"].$used                 = false;
GPIO2["3"].$used                 = false;
GPIO2["4"].$used                 = false;
GPIO2["5"].$used                 = false;
GPIO2["6"].$used                 = false;
GPIO2["7"].$used                 = false;
GPIO2["8"].$used                 = false;
GPIO2["9"].$used                 = false;
GPIO2["10"].$used                = false;
GPIO2["11"].$used                = false;
GPIO2["12"].$used                = false;
GPIO2["13"].$used                = false;
GPIO2["14"].$used                = false;
GPIO2["15"].$used                = false;
GPIO2["16"].$used                = false;
GPIO2["17"].$used                = false;
GPIO2["18"].$used                = false;
GPIO2["19"].$used                = false;
GPIO2["20"].$used                = false;
GPIO2["21"].$used                = false;
GPIO2["22"].$used                = false;
GPIO2["23"].$used                = false;
GPIO2["24"].$assign              = "MCAN0_TX";
GPIO2["24"].$used                = true;
GPIO2["25"].$assign              = "MCAN0_RX";
GPIO2["25"].$used                = true;
GPIO2["26"].$used                = false;
GPIO2["27"].$used                = false;
GPIO2["28"].$used                = false;
GPIO2["29"].$used                = false;
GPIO2["30"].$used                = false;
GPIO2["31"].$used                = false;
GPIO2["32"].$used                = false;
GPIO2["33"].$used                = false;
GPIO2["34"].$used                = false;
GPIO2["35"].$used                = false;
GPIO2["36"].$used                = false;
GPIO2["37"].$used                = false;
GPIO2["38"].$used                = false;
GPIO2["39"].$used                = false;
GPIO2["40"].$used                = false;
GPIO2["41"].$used                = false;
GPIO2["42"].$assign              = "MMC1_DAT3";
GPIO2["42"].$used                = false;
GPIO2["43"].$assign              = "MMC1_DAT2";
GPIO2["43"].$used                = false;
GPIO2["44"].$assign              = "MMC1_DAT1";
GPIO2["44"].$used                = false;
GPIO2["45"].$assign              = "MMC1_DAT0";
GPIO2["45"].$used                = false;
GPIO2["46"].$used                = false;
GPIO2["47"].$used                = false;
GPIO2["48"].$used                = false;
GPIO2["49"].$used                = false;
GPIO2["50"].$used                = false;
GPIO2["51"].$used                = false;
GPIO2["52"].$used                = false;
GPIO2["53"].$used                = false;
GPIO2["54"].$used                = false;
GPIO2["55"].$used                = false;
GPIO2["56"].$used                = false;
GPIO2["57"].$used                = false;
GPIO2["58"].$used                = false;
GPIO2["59"].$used                = false;
GPIO2["60"].$used                = false;
GPIO2["61"].$used                = false;
GPIO2["62"].$used                = false;
GPIO2["63"].$used                = false;
GPIO2["64"].$used                = false;
GPIO2["65"].$used                = false;
GPIO2["66"].$used                = false;
GPIO2["67"].$used                = false;
GPIO2["68"].$used                = false;
GPIO2["69"].$used                = false;
GPIO2["70"].$used                = false;
GPIO2["71"].$used                = false;
GPIO2["72"].$used                = false;
GPIO2["73"].$used                = false;
GPIO2["74"].$used                = false;
GPIO2["75"].$used                = false;
GPIO2["76"].$used                = false;
GPIO2["77"].$used                = false;
GPIO2["78"].$used                = false;
GPIO2["79"].$used                = false;
GPIO2["80"].$used                = false;
GPIO2["81"].$used                = false;
GPIO2["82"].$used                = false;
GPIO2["83"].$used                = false;
GPIO2["84"].$used                = false;
GPIO2["85"].$used                = false;
GPIO2["86"].$used                = false;
GPIO2["87"].$used                = false;
GPIO2["88"].$used                = false;
GPIO2["89"].$used                = false;
GPIO2["90"].$used                = false;
GPIO2["91"].$used                = false;
GPIO2.$name                      = "MyGPIO2";
GPIO2.$assignVoltage             = "3.3 V";
const I2C1                       = scripting.addPeripheral("I2C");
I2C1.$name                       = "MyI2C1";
I2C1.$assign                     = "I2C1";
I2C1.SCL.$assign                 = "I2C1_SCL";
I2C1.SDA.$assign                 = "I2C1_SDA";
const I2C2                       = scripting.addPeripheral("I2C");
I2C2.$name                       = "MyI2C2";
I2C2.$assign                     = "I2C3";
I2C2.SCL.$assign                 = "UART0_CTSn";
I2C2.SDA.$assign                 = "UART0_RTSn";
const I2C3                       = scripting.addPeripheral("I2C");
I2C3.$name                       = "MyI2C3";
I2C3.$assign                     = "I2C0";
I2C3.$assignVoltage              = "3.3 V";
I2C3.SCL.$assign                 = "I2C0_SCL";
I2C3.SDA.$assign                 = "I2C0_SDA";
const JTAG1                      = scripting.addPeripheral("JTAG");
JTAG1.$name                      = "MyJTAG1";
JTAG1.$assignVoltage             = "3.3 V";
const MCASP1                     = scripting.addPeripheral("MCASP");
MCASP1.$useCase                  = "MCASP_1";
MCASP1.$name                     = "MyMCASP0";
MCASP1.ACLKR.$assign             = "MCASP0_ACLKR";
MCASP1.ACLKR.$used               = false;
MCASP1.ACLKX.$assign             = "MCASP0_ACLKX";
MCASP1.AFSR.$assign              = "MCASP0_AFSR";
MCASP1.AFSR.$used                = false;
MCASP1.AFSX.$assign              = "MCASP0_AFSX";
MCASP1.$pinGroup.AXR0.$assign    = "MCASP0_AXR0";
MCASP1.$pinGroup.AXR1.$assign    = "MCASP0_AXR1";
MCASP1.$pinGroup.AXR2.$assign    = "MCASP0_AXR2";
MCASP1.$pinGroup.AXR3.$assign    = "MCASP0_AXR3";
MCASP1.$pinGroup.AXR4.$used      = false;
MCASP1.$pinGroup.AXR5.$used      = false;
MCASP1.$pinGroup.AXR6.$used      = false;
MCASP1.$pinGroup.AXR7.$used      = false;
MCASP1.$pinGroup.AXR8.$used      = false;
MCASP1.$pinGroup.AXR9.$used      = false;
MCASP1.$pinGroup.AXR10.$used     = false;
MCASP1.$pinGroup.AXR11.$used     = false;
MCASP1.$pinGroup.AXR12.$used     = false;
MCASP1.$pinGroup.AXR13.$used     = false;
MCASP1.$pinGroup.AXR14.$used     = false;
MCASP1.$pinGroup.AXR15.$used     = false;
MCASP1.$pinGroup.$numPins        = 4;
const MCU_I2C1                   = scripting.addPeripheral("MCU_I2C");
MCU_I2C1.$name                   = "MyMCU_I2C1";
const MCU_OSC1                   = scripting.addPeripheral("MCU_OSC");
MCU_OSC1.$name                   = "MyMCU_OSC1";
const MCU_SPI1                   = scripting.addPeripheral("MCU_SPI");
MCU_SPI1.$name                   = "MyMCU_SPI1";
MCU_SPI1.CS1.$used               = false;
MCU_SPI1.CS2.$used               = false;
MCU_SPI1.CS3.$used               = false;
const MCU_SYSTEM1                = scripting.addPeripheral("MCU_SYSTEM");
MCU_SYSTEM1.$name                = "MyMCU_SYSTEM1";
MCU_SYSTEM1.$assignVoltage       = "3.3 V";
MCU_SYSTEM1.MCU_OBSCLK0.$assign  = "MCU_SPI0_CS1";
MCU_SYSTEM1.MCU_OBSCLK0.$used    = true;
MCU_SYSTEM1.MCU_SYSCLKOUT0.$used = false;
const MCU_UART1                  = scripting.addPeripheral("MCU_UART");
MCU_UART1.$name                  = "MyMCU_UART1";
const MDIO1                      = scripting.addPeripheral("MDIO");
MDIO1.$name                      = "MyMDIO1";
const MMC01                      = scripting.addPeripheral("MMC0");
MMC01.$name                      = "MyMMC01";
MMC01.CLK.pu_pd                  = "nopull";
MMC01.CLK.rx                     = false;
const MMC11                      = scripting.addPeripheral("MMC1");
MMC11.$name                      = "MyMMC11";
MMC11.CMD.pu_pd                  = "nopull";
MMC11.CLK.pu_pd                  = "nopull";
MMC11.CLK.rx                     = false;
MMC11.DAT0.pu_pd                 = "nopull";
MMC11.SDCD.pu_pd                 = "nopull";
const MMC21                      = scripting.addPeripheral("MMC2");
MMC21.$useCase                   = "MMC2_3";
MMC21.$name                      = "MyMMC21";
MMC21.CMD.pu_pd                  = "nopull";
MMC21.CLK.pu_pd                  = "nopull";
MMC21.CLK.rx                     = false;
MMC21.DAT0.pu_pd                 = "nopull";
MMC21.DAT1.pu_pd                 = "nopull";
MMC21.DAT2.pu_pd                 = "nopull";
MMC21.DAT3.pu_pd                 = "nopull";
MMC21.SDCD.pu_pd                 = "nopull";
MMC21.SDCD.$used                 = false;
MMC21.SDWP.$used                 = false;
const RGMII1                     = scripting.addPeripheral("RGMII");
RGMII1.$name                     = "MyRGMII1";
const RMII1                      = scripting.addPeripheral("RMII");
RMII1.$name                      = "MyRMII1";
const SPI1                       = scripting.addPeripheral("SPI");
SPI1.$name                       = "MySPI1";
SPI1.$assign                     = "SPI1";
SPI1.CLK.$assign                 = "OSPI0_D5";
SPI1.CS0.$assign                 = "OSPI0_D4";
SPI1.CS1.$assign                 = "OSPI0_CSn2";
SPI1.CS2.$used                   = false;
SPI1.CS3.$used                   = false;
SPI1.D0.$assign                  = "OSPI0_D6";
SPI1.D1.$assign                  = "OSPI0_D7";
const SPI2                       = scripting.addPeripheral("SPI");
SPI2.$name                       = "MySPI2";
SPI2.$assign                     = "SPI0";
SPI2.CLK.$assign                 = "SPI0_CLK";
SPI2.CS0.$assign                 = "SPI0_CS0";
SPI2.CS1.$assign                 = "SPI0_CS1";
SPI2.CS2.$used                   = false;
SPI2.CS3.$used                   = false;
SPI2.D0.$assign                  = "SPI0_D0";
SPI2.D1.$assign                  = "SPI0_D1";
const SYSTEM1                    = scripting.addPeripheral("SYSTEM");
SYSTEM1.$name                    = "MySYSTEM1";
SYSTEM1.AUDIO_EXT_REFCLK0.$used  = false;
SYSTEM1.AUDIO_EXT_REFCLK1.$used  = false;
SYSTEM1.CLKOUT0.$used            = false;
SYSTEM1.EXTINTn.$used            = true;
SYSTEM1.EXT_REFCLK1.$used        = false;
SYSTEM1.OBSCLK0.$used            = false;
SYSTEM1.SYNC0_OUT.$used          = false;
SYSTEM1.SYNC1_OUT.$used          = false;
SYSTEM1.SYNC2_OUT.$used          = false;
SYSTEM1.SYNC3_OUT.$used          = false;
SYSTEM1.SYSCLKOUT0.$used         = false;
const UART1                      = scripting.addPeripheral("UART");
UART1.$name                      = "MyUART0";
UART1.$assign                    = "USART0";
UART1.CTSn.$used                 = false;
UART1.DCDn.$used                 = false;
UART1.DSRn.$used                 = false;
UART1.DTRn.$used                 = false;
UART1.RIn.$used                  = false;
UART1.RTSn.$used                 = false;
UART1.RXD.$assign                = "UART0_RXD";
UART1.TXD.$assign                = "UART0_TXD";
const UART2                      = scripting.addPeripheral("UART");
UART2.$name                      = "MyUART1";
UART2.$assign                    = "USART2";
UART2.CTSn.$assign               = "VOUT0_PCLK";
UART2.DCDn.$used                 = false;
UART2.DSRn.$used                 = false;
UART2.DTRn.$used                 = false;
UART2.RIn.$used                  = false;
UART2.RTSn.$assign               = "VOUT0_VSYNC";
UART2.RXD.$assign                = "VOUT0_DATA0";
UART2.TXD.$assign                = "VOUT0_DATA1";
const UART3                      = scripting.addPeripheral("UART");
UART3.$name                      = "MyUART2";
UART3.$assign                    = "USART4";
UART3.CTSn.$used                 = false;
UART3.DCDn.$used                 = false;
UART3.DSRn.$used                 = false;
UART3.DTRn.$used                 = false;
UART3.RIn.$used                  = false;
UART3.RTSn.$used                 = false;
UART3.RXD.$assign                = "VOUT0_DATA4";
UART3.TXD.$assign                = "VOUT0_DATA5";
const USB1                       = scripting.addPeripheral("USB");
USB1.$name                       = "MyUSB1";
USB1.$assignVoltage              = "3.3 V";
const WKUP_I2C1                  = scripting.addPeripheral("WKUP_I2C");
WKUP_I2C1.$name                  = "MyWKUP_I2C1";
const WKUP_LFOSC1                = scripting.addPeripheral("WKUP_LFOSC");
WKUP_LFOSC1.$name                = "MyWKUP_LFOSC1";
const WKUP_SYSTEM1               = scripting.addPeripheral("WKUP_SYSTEM");
WKUP_SYSTEM1.$name               = "MyWKUP_SYSTEM1";
WKUP_SYSTEM1.$assign             = "WKUP_SYSTEM";
WKUP_SYSTEM1.$assignVoltage      = "3.3 V";
const WKUP_TIMER1                = scripting.addPeripheral("WKUP_TIMER");
WKUP_TIMER1.$name                = "MyWKUP_TIMER1";
const WKUP_UART1                 = scripting.addPeripheral("WKUP_UART");
WKUP_UART1.$name                 = "MyWKUP_UART1";

/**
 * Pinmux solution for unlocked pins/peripherals. This ensures that minor changes to the automatic solver in a future
 * version of the tool will not impact the pinmux you originally saw.  These lines can be completely deleted in order to
 * re-solve from scratch.
 */
DDRSS1.$suggestSolution                      = "DDR0";
DDRSS1.A0.$suggestSolution                   = "DDR0_A0";
DDRSS1.A1.$suggestSolution                   = "DDR0_A1";
DDRSS1.A10.$suggestSolution                  = "DDR0_A10";
DDRSS1.A11.$suggestSolution                  = "DDR0_A11";
DDRSS1.A12.$suggestSolution                  = "DDR0_A12";
DDRSS1.A13.$suggestSolution                  = "DDR0_A13";
DDRSS1.A2.$suggestSolution                   = "DDR0_A2";
DDRSS1.A3.$suggestSolution                   = "DDR0_A3";
DDRSS1.A4.$suggestSolution                   = "DDR0_A4";
DDRSS1.A5.$suggestSolution                   = "DDR0_A5";
DDRSS1.A6.$suggestSolution                   = "DDR0_A6";
DDRSS1.A7.$suggestSolution                   = "DDR0_A7";
DDRSS1.A8.$suggestSolution                   = "DDR0_A8";
DDRSS1.A9.$suggestSolution                   = "DDR0_A9";
DDRSS1.ACT_n.$suggestSolution                = "DDR0_ACT_n";
DDRSS1.ALERT_n.$suggestSolution              = "DDR0_ALERT_n";
DDRSS1.BA0.$suggestSolution                  = "DDR0_BA0";
DDRSS1.BA1.$suggestSolution                  = "DDR0_BA1";
DDRSS1.BG0.$suggestSolution                  = "DDR0_BG0";
DDRSS1.BG1.$suggestSolution                  = "DDR0_BG1";
DDRSS1.CAS_n.$suggestSolution                = "DDR0_CAS_n";
DDRSS1.CK0.$suggestSolution                  = "DDR0_CK0";
DDRSS1.CK0_n.$suggestSolution                = "DDR0_CK0_n";
DDRSS1.CKE0.$suggestSolution                 = "DDR0_CKE0";
DDRSS1.CKE1.$suggestSolution                 = "DDR0_CKE1";
DDRSS1.CS0_n.$suggestSolution                = "DDR0_CS0_n";
DDRSS1.CS1_n.$suggestSolution                = "DDR0_CS1_n";
DDRSS1.DM0.$suggestSolution                  = "DDR0_DM0";
DDRSS1.DM1.$suggestSolution                  = "DDR0_DM1";
DDRSS1.DQ0.$suggestSolution                  = "DDR0_DQ0";
DDRSS1.DQ1.$suggestSolution                  = "DDR0_DQ1";
DDRSS1.DQ10.$suggestSolution                 = "DDR0_DQ10";
DDRSS1.DQ11.$suggestSolution                 = "DDR0_DQ11";
DDRSS1.DQ12.$suggestSolution                 = "DDR0_DQ12";
DDRSS1.DQ13.$suggestSolution                 = "DDR0_DQ13";
DDRSS1.DQ14.$suggestSolution                 = "DDR0_DQ14";
DDRSS1.DQ15.$suggestSolution                 = "DDR0_DQ15";
DDRSS1.DQ2.$suggestSolution                  = "DDR0_DQ2";
DDRSS1.DQ3.$suggestSolution                  = "DDR0_DQ3";
DDRSS1.DQ4.$suggestSolution                  = "DDR0_DQ4";
DDRSS1.DQ5.$suggestSolution                  = "DDR0_DQ5";
DDRSS1.DQ6.$suggestSolution                  = "DDR0_DQ6";
DDRSS1.DQ7.$suggestSolution                  = "DDR0_DQ7";
DDRSS1.DQ8.$suggestSolution                  = "DDR0_DQ8";
DDRSS1.DQ9.$suggestSolution                  = "DDR0_DQ9";
DDRSS1.DQS0.$suggestSolution                 = "DDR0_DQS0";
DDRSS1.DQS0_n.$suggestSolution               = "DDR0_DQS0_n";
DDRSS1.DQS1.$suggestSolution                 = "DDR0_DQS1";
DDRSS1.DQS1_n.$suggestSolution               = "DDR0_DQS1_n";
DDRSS1.ODT0.$suggestSolution                 = "DDR0_ODT0";
DDRSS1.ODT1.$suggestSolution                 = "DDR0_ODT1";
DDRSS1.PAR.$suggestSolution                  = "DDR0_PAR";
DDRSS1.RAS_n.$suggestSolution                = "DDR0_RAS_n";
DDRSS1.RESET0_n.$suggestSolution             = "DDR0_RESET0_n";
DDRSS1.WE_n.$suggestSolution                 = "DDR0_WE_n";
DDRSS1.CAL0.$suggestSolution                 = "DDR0_CAL0";
GPIO1.$suggestSolution                       = "GPIO0";
GPIO2.$suggestSolution                       = "GPIO1";
JTAG1.$suggestSolution                       = "MCU_DEBUG0";
JTAG1.EMU0.$suggestSolution                  = "EMU0";
JTAG1.EMU1.$suggestSolution                  = "EMU1";
JTAG1.TCK.$suggestSolution                   = "TCK";
JTAG1.TDI.$suggestSolution                   = "TDI";
JTAG1.TDO.$suggestSolution                   = "TDO";
JTAG1.TMS.$suggestSolution                   = "TMS";
JTAG1.TRSTn.$suggestSolution                 = "TRSTn";
MCASP1.$suggestSolution                      = "MCASP0";
MCU_I2C1.$suggestSolution                    = "MCU_I2C0";
MCU_I2C1.SCL.$suggestSolution                = "MCU_I2C0_SCL";
MCU_I2C1.SDA.$suggestSolution                = "MCU_I2C0_SDA";
MCU_OSC1.$suggestSolution                    = "MCU_OSC0";
MCU_OSC1.XI.$suggestSolution                 = "MCU_OSC0_XI";
MCU_OSC1.XO.$suggestSolution                 = "MCU_OSC0_XO";
MCU_SPI1.$suggestSolution                    = "MCU_SPI0";
MCU_SPI1.CLK.$suggestSolution                = "MCU_SPI0_CLK";
MCU_SPI1.CS0.$suggestSolution                = "MCU_SPI0_CS0";
MCU_SPI1.D0.$suggestSolution                 = "MCU_SPI0_D0";
MCU_SPI1.D1.$suggestSolution                 = "MCU_SPI0_D1";
MCU_SYSTEM1.$suggestSolution                 = "MCU_SYSTEM0";
MCU_SYSTEM1.MCU_ERRORn.$suggestSolution      = "MCU_ERRORn";
MCU_SYSTEM1.MCU_EXT_REFCLK0.$suggestSolution = "MCU_MCAN1_TX";
MCU_SYSTEM1.MCU_PORz.$suggestSolution        = "MCU_PORz";
MCU_SYSTEM1.MCU_RESETSTATz.$suggestSolution  = "MCU_RESETSTATz";
MCU_SYSTEM1.MCU_RESETz.$suggestSolution      = "MCU_RESETz";
MCU_UART1.$suggestSolution                   = "MCU_USART0";
MCU_UART1.CTSn.$suggestSolution              = "MCU_UART0_CTSn";
MCU_UART1.RTSn.$suggestSolution              = "MCU_UART0_RTSn";
MCU_UART1.RXD.$suggestSolution               = "MCU_UART0_RXD";
MCU_UART1.TXD.$suggestSolution               = "MCU_UART0_TXD";
MDIO1.$suggestSolution                       = "MDIO0";
MDIO1.MDC.$suggestSolution                   = "MDIO0_MDC";
MDIO1.MDIO.$suggestSolution                  = "MDIO0_MDIO";
MMC01.$suggestSolution                       = "MMC0";
MMC01.CMD.$suggestSolution                   = "MMC0_CMD";
MMC01.CLK.$suggestSolution                   = "MMC0_CLK";
MMC01.DAT0.$suggestSolution                  = "MMC0_DAT0";
MMC01.DAT1.$suggestSolution                  = "MMC0_DAT1";
MMC01.DAT2.$suggestSolution                  = "MMC0_DAT2";
MMC01.DAT3.$suggestSolution                  = "MMC0_DAT3";
MMC01.DAT4.$suggestSolution                  = "MMC0_DAT4";
MMC01.DAT5.$suggestSolution                  = "MMC0_DAT5";
MMC01.DAT6.$suggestSolution                  = "MMC0_DAT6";
MMC01.DAT7.$suggestSolution                  = "MMC0_DAT7";
MMC11.$suggestSolution                       = "MMC1";
MMC11.CMD.$suggestSolution                   = "MMC1_CMD";
MMC11.CLK.$suggestSolution                   = "MMC1_CLK";
MMC11.DAT0.$suggestSolution                  = "MMC1_DAT0";
MMC11.DAT1.$suggestSolution                  = "MMC1_DAT1";
MMC11.DAT2.$suggestSolution                  = "MMC1_DAT2";
MMC11.DAT3.$suggestSolution                  = "MMC1_DAT3";
MMC11.SDCD.$suggestSolution                  = "MMC1_SDCD";
MMC11.SDWP.$suggestSolution                  = "MMC1_SDWP";
MMC21.$suggestSolution                       = "MMC2";
MMC21.CMD.$suggestSolution                   = "MMC2_CMD";
MMC21.CLK.$suggestSolution                   = "MMC2_CLK";
MMC21.DAT0.$suggestSolution                  = "MMC2_DAT0";
MMC21.DAT1.$suggestSolution                  = "MMC2_DAT1";
MMC21.DAT2.$suggestSolution                  = "MMC2_DAT2";
MMC21.DAT3.$suggestSolution                  = "MMC2_DAT3";
RGMII1.$suggestSolution                      = "RGMII2";
RGMII1.RD0.$suggestSolution                  = "RGMII2_RD0";
RGMII1.RD1.$suggestSolution                  = "RGMII2_RD1";
RGMII1.RD2.$suggestSolution                  = "RGMII2_RD2";
RGMII1.RD3.$suggestSolution                  = "RGMII2_RD3";
RGMII1.RXC.$suggestSolution                  = "RGMII2_RXC";
RGMII1.RX_CTL.$suggestSolution               = "RGMII2_RX_CTL";
RGMII1.TD0.$suggestSolution                  = "RGMII2_TD0";
RGMII1.TD1.$suggestSolution                  = "RGMII2_TD1";
RGMII1.TD2.$suggestSolution                  = "RGMII2_TD2";
RGMII1.TD3.$suggestSolution                  = "RGMII2_TD3";
RGMII1.TXC.$suggestSolution                  = "RGMII2_TXC";
RGMII1.TX_CTL.$suggestSolution               = "RGMII2_TX_CTL";
RMII1.$suggestSolution                       = "RMII1";
RMII1.CRS_DV.$suggestSolution                = "RGMII1_TXC";
RMII1.REF_CLK.$suggestSolution               = "RGMII1_RXC";
RMII1.RXD0.$suggestSolution                  = "RGMII1_RD0";
RMII1.RXD1.$suggestSolution                  = "RGMII1_RD1";
RMII1.RX_ER.$suggestSolution                 = "RGMII1_RX_CTL";
RMII1.TXD0.$suggestSolution                  = "RGMII1_TD0";
RMII1.TXD1.$suggestSolution                  = "RGMII1_TD1";
RMII1.TX_EN.$suggestSolution                 = "RGMII1_TX_CTL";
SYSTEM1.$suggestSolution                     = "SYSTEM0";
SYSTEM1.EXTINTn.$suggestSolution             = "EXTINTn";
SYSTEM1.PORz_OUT.$suggestSolution            = "PORz_OUT";
SYSTEM1.RESETSTATz.$suggestSolution          = "RESETSTATz";
SYSTEM1.RESET_REQz.$suggestSolution          = "RESET_REQz";
USB1.$suggestSolution                        = "USB0";
USB1.DM.$suggestSolution                     = "USB0_DM";
USB1.DP.$suggestSolution                     = "USB0_DP";
USB1.DRVVBUS.$suggestSolution                = "USB0_DRVVBUS";
USB1.RCALIB.$suggestSolution                 = "USB0_RCALIB";
USB1.VBUS.$suggestSolution                   = "USB0_VBUS";
WKUP_I2C1.$suggestSolution                   = "WKUP_I2C0";
WKUP_I2C1.SCL.$suggestSolution               = "WKUP_I2C0_SCL";
WKUP_I2C1.SDA.$suggestSolution               = "WKUP_I2C0_SDA";
WKUP_LFOSC1.$suggestSolution                 = "WKUP_LFOSC0";
WKUP_LFOSC1.XI.$suggestSolution              = "WKUP_LFOSC0_XI";
WKUP_LFOSC1.XO.$suggestSolution              = "WKUP_LFOSC0_XO";
WKUP_SYSTEM1.WKUP_CLKOUT0.$suggestSolution   = "WKUP_CLKOUT0";
WKUP_SYSTEM1.PMIC_LPM_EN0.$suggestSolution   = "PMIC_LPM_EN0";
WKUP_TIMER1.$suggestSolution                 = "WKUP_DMTIMER0";
WKUP_TIMER1.TIMER_IO.$suggestSolution        = "MCU_MCAN0_TX";
WKUP_UART1.$suggestSolution                  = "WKUP_USART0";
WKUP_UART1.CTSn.$suggestSolution             = "WKUP_UART0_CTSn";
WKUP_UART1.RTSn.$suggestSolution             = "WKUP_UART0_RTSn";
WKUP_UART1.RXD.$suggestSolution              = "WKUP_UART0_RXD";
WKUP_UART1.TXD.$suggestSolution              = "WKUP_UART0_TXD";
