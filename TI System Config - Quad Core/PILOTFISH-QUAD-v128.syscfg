/**
 *
 * @cliArgs --device "AM62x" --part "AM6234-G" --package "ALW"
 * @versions {"tool":"1.28.0+4712"}
 */

/**
 * Import the modules used in this configuration.
 */
const powerDomains = scripting.addModule("/ti/corePinmux/powerDomains");
const DDRSS        = scripting.addModule("/ti/peripherals/DDRSS");
const DDRSS1       = DDRSS.addInstance();
const DSS          = scripting.addModule("/ti/peripherals/DSS");
const DSS1         = DSS.addInstance();
const EPWM         = scripting.addModule("/ti/peripherals/EPWM");
const EPWM1        = EPWM.addInstance();
const GPIO         = scripting.addModule("/ti/peripherals/GPIO");
const GPIO1        = GPIO.addInstance();
const GPIO2        = GPIO.addInstance();
const I2C          = scripting.addModule("/ti/peripherals/I2C");
const I2C1         = I2C.addInstance();
const I2C2         = I2C.addInstance();
const I2C3         = I2C.addInstance();
const JTAG         = scripting.addModule("/ti/peripherals/JTAG");
const JTAG1        = JTAG.addInstance();
const MCASP        = scripting.addModule("/ti/peripherals/MCASP", {}, false);
const MCASP1       = MCASP.addInstance();
const MCU_I2C      = scripting.addModule("/ti/peripherals/MCU_I2C");
const MCU_I2C1     = MCU_I2C.addInstance();
const MCU_OSC      = scripting.addModule("/ti/peripherals/MCU_OSC");
const MCU_OSC1     = MCU_OSC.addInstance();
const MCU_SPI      = scripting.addModule("/ti/peripherals/MCU_SPI");
const MCU_SPI1     = MCU_SPI.addInstance();
const MCU_SYSTEM   = scripting.addModule("/ti/peripherals/MCU_SYSTEM");
const MCU_SYSTEM1  = MCU_SYSTEM.addInstance();
const MCU_UART     = scripting.addModule("/ti/peripherals/MCU_UART");
const MCU_UART1    = MCU_UART.addInstance();
const MDIO         = scripting.addModule("/ti/peripherals/MDIO");
const MDIO1        = MDIO.addInstance();
const MMC0         = scripting.addModule("/ti/peripherals/MMC0");
const MMC01        = MMC0.addInstance();
const MMC1         = scripting.addModule("/ti/peripherals/MMC1");
const MMC11        = MMC1.addInstance();
const MMC2         = scripting.addModule("/ti/peripherals/MMC2");
const MMC21        = MMC2.addInstance();
const RGMII        = scripting.addModule("/ti/peripherals/RGMII");
const RGMII1       = RGMII.addInstance();
const SPI          = scripting.addModule("/ti/peripherals/SPI");
const SPI1         = SPI.addInstance();
const SYSTEM       = scripting.addModule("/ti/peripherals/SYSTEM");
const SYSTEM1      = SYSTEM.addInstance();
const UART         = scripting.addModule("/ti/peripherals/UART");
const UART1        = UART.addInstance();
const UART2        = UART.addInstance();
const UART3        = UART.addInstance();
const USB          = scripting.addModule("/ti/peripherals/USB");
const USB1         = USB.addInstance();
const USB2         = USB.addInstance();
const WKUP_LFOSC   = scripting.addModule("/ti/peripherals/WKUP_LFOSC");
const WKUP_LFOSC1  = WKUP_LFOSC.addInstance();
const WKUP_SYSTEM  = scripting.addModule("/ti/peripherals/WKUP_SYSTEM");
const WKUP_SYSTEM1 = WKUP_SYSTEM.addInstance();

/**
 * Write custom configuration values to the imported modules.
 */
powerDomains["VDDA_1P8_USB-VDDA_3P3_USB"] = "3.3 V";
powerDomains.VDDSHV3                      = "3.3 V";
powerDomains.VDDSHV2                      = "3.3 V";
powerDomains.VDDSHV1                      = "3.3 V";
powerDomains.VDDSHV0                      = "3.3 V";
powerDomains["VDDS_DDR-VDDS_DDR_C"]       = "1.2 V";
powerDomains.VDDSHV_MCU                   = "3.3 V";
powerDomains.VDDSHV_CANUART               = "3.3 V";
powerDomains.VDDSHV6                      = "3.3 V";
powerDomains.VDDSHV5                      = "3.3 V";

DDRSS1.$name              = "DDRSS1_DDR_MEMORY";
DDRSS1.peripheral.$assign = "DDR0";

DSS1.useCases           = "DSS_1";
DSS1.$name              = "DSS1_DISPLAY";
DSS1.peripheral.$assign = "DSS0";

EPWM1.useCases = "EPWM_1";
EPWM1.$name    = "EPWM1_20V0_PWM";

GPIO1.$name                          = "MyGPIO1";
GPIO1.associatedPins.create(11);
GPIO1.associatedPins[0].$name        = "GPIO1_0_USB0_Ocn";
GPIO1.associatedPins[0].GPIO.$assign = "RGMII2_TD3";
GPIO1.associatedPins[1].$name        = "GPIO0_10_LED1";
GPIO1.associatedPins[2].$name        = "BOOTMODE00";
GPIO1.associatedPins[3].$name        = "BOOTMODE01_eMMC_nRST";
GPIO1.associatedPins[4].$name        = "BOOTMODE02";
GPIO1.associatedPins[5].$name        = "GPIO1_3_KNOB_I2C_nRST";
GPIO1.associatedPins[5].GPIO.$assign = "RGMII2_RD2";
GPIO1.associatedPins[6].$name        = "GPIO1_6_AVAILABLE";
GPIO1.associatedPins[6].GPIO.$assign = "RGMII2_RD3";
GPIO1.associatedPins[7].$name        = "BOOTMODE03";
GPIO1.associatedPins[8].$name        = "GPIO1_17_AVAILABLE";
GPIO1.associatedPins[8].GPIO.$assign = "SPI0_CLK";
GPIO1.associatedPins[9].$name        = "BOOTMODE04";
GPIO1.associatedPins[10].$name       = "BOOTMODE05";

GPIO2.$name                           = "MyGPIO2";
GPIO2.associatedPins.create(37);
GPIO2.associatedPins[0].$name         = "GPIO0_0_ULT_MUTE";
GPIO2.associatedPins[0].GPIO.$assign  = "OSPI0_CLK";
GPIO2.associatedPins[1].$name         = "GPIO0_1_CTP_RST";
GPIO2.associatedPins[1].GPIO.$assign  = "OSPI0_LBCLKO";
GPIO2.associatedPins[2].$name         = "GPIO0_2_RTC_nINT";
GPIO2.associatedPins[2].GPIO.$assign  = "OSPI0_DQS";
GPIO2.associatedPins[3].$name         = "GPIO0_3_LED_CTRL_nRESET";
GPIO2.associatedPins[3].GPIO.$assign  = "OSPI0_D0";
GPIO2.associatedPins[4].$name         = "GPIO0_4_TFT_SLEEP";
GPIO2.associatedPins[4].GPIO.$assign  = "OSPI0_D1";
GPIO2.associatedPins[5].$name         = "GPIO0_5_3V3_G_EN";
GPIO2.associatedPins[5].GPIO.$assign  = "OSPI0_D2";
GPIO2.associatedPins[6].$name         = "GPIO0_6_DANTE_nRST";
GPIO2.associatedPins[6].GPIO.$assign  = "OSPI0_D3";
GPIO2.associatedPins[7].$name         = "BOOTMODE06";
GPIO2.associatedPins[8].$name         = "GPIO0_11_AVAILABLE";
GPIO2.associatedPins[8].GPIO.$assign  = "OSPI0_CSn0";
GPIO2.associatedPins[9].$name         = "GPIO0_12_PHY_nRST";
GPIO2.associatedPins[9].GPIO.$assign  = "OSPI0_CSn1";
GPIO2.associatedPins[10].$name        = "GPIO0_13_LCD_RESET";
GPIO2.associatedPins[10].GPIO.$assign = "OSPI0_CSn2";
GPIO2.associatedPins[11].$name        = "GPIO0_14_BT_GPIO1";
GPIO2.associatedPins[11].GPIO.$assign = "OSPI0_CSn3";
GPIO2.associatedPins[12].$name        = "BOOTMODE07";
GPIO2.associatedPins[13].$name        = "GPIO0_31_BT_nRST";
GPIO2.associatedPins[14].$name        = "GPIO0_32_VAR_2";
GPIO2.associatedPins[15].$name        = "GPIO0_89_WL_nRST";
GPIO2.associatedPins[15].GPIO.$assign = "RGMII2_TD0";
GPIO2.associatedPins[16].$name        = "GPIO0_33_AVAILABLE";
GPIO2.associatedPins[17].$name        = "GPIO0_34_AVAILABLE";
GPIO2.associatedPins[18].$name        = "GPIO0_35_VAR_1";
GPIO2.associatedPins[19].$name        = "GPIO0_36_VAR_0";
GPIO2.associatedPins[20].$name        = "GPIO0_37_AVAILABLE";
GPIO2.associatedPins[21].$name        = "GPIO0_40_BT_PDn";
GPIO2.associatedPins[22].$name        = "GPIO0_41_AVAILABLE";
GPIO2.associatedPins[23].$name        = "GPIO0_42_AVAILABLE";
GPIO2.associatedPins[24].$name        = "GPIO0_87_AVAILABLE";
GPIO2.associatedPins[25].$name        = "GPIO0_88_AVAILABLE";
GPIO2.associatedPins[26].$name        = "GPIO0_90_BT_nWAKE";
GPIO2.associatedPins[27].$name        = "GPIO0_91_AVAILABLE";
GPIO2.associatedPins[28].$name        = "GPIO1_1_CTP_INT";
GPIO2.associatedPins[29].$name        = "GPIO1_2_KNOB_I2C_INT";
GPIO2.associatedPins[30].$name        = "GPIO1_3_FACTORY_RESET";
GPIO2.associatedPins[31].$name        = "GPIO1_4_BT_INT";
GPIO2.associatedPins[32].$name        = "GPIO1_16_LED3";
GPIO2.associatedPins[33].$name        = "GPIO1_18_LED2";
GPIO2.associatedPins[34].$name        = "GPIO1_19_LED0";
GPIO2.associatedPins[35].$name        = "MCAN0_TX_AVAILABLE";
GPIO2.associatedPins[36].$name        = "MCAN0_RX_AVAILABLE";

I2C1.$name              = "I2C0_PMIC";
I2C1.peripheral.$assign = "I2C0";

I2C2.$name              = "I2C3_LED_Driver";
I2C2.peripheral.$assign = "I2C3";

I2C3.$name = "I2C2_CAP_TOUCH";

JTAG1.$name              = "JTAG1";
JTAG1.peripheral.$assign = "MCU_DEBUG0";

MCASP1.useCases           = "MCASP_1";
MCASP1.ANY_PINS           = 2;
MCASP1.$name              = "MCASP0";
MCASP1.peripheral.$assign = "MCASP0";

MCU_I2C1.$name = "MCU_I2C0_UNUSED";

MCU_OSC1.$name = "MCU_OSC1";

MCU_SPI1.useCases = "MCU_SPI_1";
MCU_SPI1.$name    = "MCU_SPI1_ADC";

MCU_SYSTEM1.$name                           = "MCU_SYSTEM1";
MCU_SYSTEM1.peripheral.MCU_OBSCLK0.$assign  = "MCU_SPI0_CS1";
MCU_SYSTEM1.peripheral.MCU_OBSCLK0.$used    = true;
MCU_SYSTEM1.peripheral.MCU_SYSCLKOUT0.$used = false;
scripting.suppress("Voltage conflict,VDDS_OSC is set to 1\\.8 V", MCU_SYSTEM1.peripheral, "MCU_ERRORn");
scripting.suppress("Voltage conflict,VDDS_OSC is set to 1\\.8 V", MCU_SYSTEM1.peripheral, "MCU_PORz");

MCU_UART1.$name = "MCU_UART1";

MDIO1.$name              = "MDIO1_ETH";
MDIO1.peripheral.$assign = "MDIO0";

MMC01.useCases           = "MMC0_3";
MMC01.$name              = "MMC0_EMMC";
MMC01.peripheral.$assign = "MMC0";

MMC11.useCases                = "MMC1_3";
MMC11.$name                   = "MMC1_Micro_SD";
MMC11.peripheral.$assign      = "MMC1";
MMC11.peripheral.CLK.$assign  = "MMC1_CLK";
MMC11.peripheral.CMD.$assign  = "MMC1_CMD";
MMC11.peripheral.DAT0.pu_pd   = "pu";
MMC11.peripheral.DAT0.$assign = "MMC1_DAT0";
MMC11.peripheral.DAT1.pu_pd   = "pu";
MMC11.peripheral.DAT1.$assign = "MMC1_DAT1";
MMC11.peripheral.DAT2.pu_pd   = "pu";
MMC11.peripheral.DAT2.$assign = "MMC1_DAT2";
MMC11.peripheral.DAT3.pu_pd   = "pu";
MMC11.peripheral.DAT3.$assign = "MMC1_DAT3";
MMC11.peripheral.SDCD.$assign = "MMC1_SDCD";
MMC11.peripheral.SDCD.$used   = true;
MMC11.peripheral.SDWP.$assign = "MMC1_SDWP";
MMC11.peripheral.SDWP.$used   = true;

MMC21.useCases              = "MMC2_2";
MMC21.$name                 = "MMC2_UNUSED_WIFI";
MMC21.peripheral.$assign    = "MMC2";
MMC21.peripheral.SDCD.$used = true;
MMC21.peripheral.SDWP.$used = true;

RGMII1.$name              = "RGMII1_ETH";
RGMII1.peripheral.$assign = "RGMII1";

SPI1.useCases           = "SPI_2";
SPI1.ANY_PINS           = 1;
SPI1.$name              = "SPI1_TFT";
SPI1.peripheral.$assign = "SPI1";

SYSTEM1.$name                        = "SYSTEM1";
SYSTEM1.peripheral.$assign           = "SYSTEM0";
SYSTEM1.peripheral.EXTINTn.$used     = true;
SYSTEM1.peripheral.EXT_REFCLK1.$used = true;

UART1.useCases           = "UART_2";
UART1.$name              = "UART1_BT_UART";
UART1.peripheral.$assign = "USART1";

UART2.useCases               = "UART_5";
UART2.$name                  = "UART6_DANTE_UART";
UART2.peripheral.$assign     = "USART6";
UART2.peripheral.RXD.$assign = "GPMC0_WAIT1";

UART3.useCases               = "UART_5";
UART3.$name                  = "UART1_UART_DEBUG";
UART3.peripheral.$assign     = "USART0";
UART3.peripheral.RXD.$assign = "UART0_RXD";
UART3.peripheral.TXD.$assign = "UART0_TXD";

USB1.$name              = "USB0";
USB1.peripheral.$assign = "USB0";

USB2.$name = "USB1_EXTRA";

WKUP_LFOSC1.$name = "WKUP_LFOSC1";

WKUP_SYSTEM1.$name                         = "WKUP_SYSTEM1";
WKUP_SYSTEM1.peripheral.WKUP_CLKOUT0.$used = false;

/**
 * Pinmux solution for unlocked pins/peripherals. This ensures that minor changes to the automatic solver in a future
 * version of the tool will not impact the pinmux you originally saw.  These lines can be completely deleted in order to
 * re-solve from scratch.
 */
DDRSS1.peripheral.A0.$suggestSolution                   = "DDR0_A0";
DDRSS1.peripheral.A1.$suggestSolution                   = "DDR0_A1";
DDRSS1.peripheral.A10.$suggestSolution                  = "DDR0_A10";
DDRSS1.peripheral.A11.$suggestSolution                  = "DDR0_A11";
DDRSS1.peripheral.A12.$suggestSolution                  = "DDR0_A12";
DDRSS1.peripheral.A13.$suggestSolution                  = "DDR0_A13";
DDRSS1.peripheral.A2.$suggestSolution                   = "DDR0_A2";
DDRSS1.peripheral.A3.$suggestSolution                   = "DDR0_A3";
DDRSS1.peripheral.A4.$suggestSolution                   = "DDR0_A4";
DDRSS1.peripheral.A5.$suggestSolution                   = "DDR0_A5";
DDRSS1.peripheral.A6.$suggestSolution                   = "DDR0_A6";
DDRSS1.peripheral.A7.$suggestSolution                   = "DDR0_A7";
DDRSS1.peripheral.A8.$suggestSolution                   = "DDR0_A8";
DDRSS1.peripheral.A9.$suggestSolution                   = "DDR0_A9";
DDRSS1.peripheral.ACT_n.$suggestSolution                = "DDR0_ACT_n";
DDRSS1.peripheral.ALERT_n.$suggestSolution              = "DDR0_ALERT_n";
DDRSS1.peripheral.BA0.$suggestSolution                  = "DDR0_BA0";
DDRSS1.peripheral.BA1.$suggestSolution                  = "DDR0_BA1";
DDRSS1.peripheral.BG0.$suggestSolution                  = "DDR0_BG0";
DDRSS1.peripheral.BG1.$suggestSolution                  = "DDR0_BG1";
DDRSS1.peripheral.CAS_n.$suggestSolution                = "DDR0_CAS_n";
DDRSS1.peripheral.CK0.$suggestSolution                  = "DDR0_CK0";
DDRSS1.peripheral.CK0_n.$suggestSolution                = "DDR0_CK0_n";
DDRSS1.peripheral.CKE0.$suggestSolution                 = "DDR0_CKE0";
DDRSS1.peripheral.CKE1.$suggestSolution                 = "DDR0_CKE1";
DDRSS1.peripheral.CS0_n.$suggestSolution                = "DDR0_CS0_n";
DDRSS1.peripheral.CS1_n.$suggestSolution                = "DDR0_CS1_n";
DDRSS1.peripheral.DM0.$suggestSolution                  = "DDR0_DM0";
DDRSS1.peripheral.DM1.$suggestSolution                  = "DDR0_DM1";
DDRSS1.peripheral.DQ0.$suggestSolution                  = "DDR0_DQ0";
DDRSS1.peripheral.DQ1.$suggestSolution                  = "DDR0_DQ1";
DDRSS1.peripheral.DQ10.$suggestSolution                 = "DDR0_DQ10";
DDRSS1.peripheral.DQ11.$suggestSolution                 = "DDR0_DQ11";
DDRSS1.peripheral.DQ12.$suggestSolution                 = "DDR0_DQ12";
DDRSS1.peripheral.DQ13.$suggestSolution                 = "DDR0_DQ13";
DDRSS1.peripheral.DQ14.$suggestSolution                 = "DDR0_DQ14";
DDRSS1.peripheral.DQ15.$suggestSolution                 = "DDR0_DQ15";
DDRSS1.peripheral.DQ2.$suggestSolution                  = "DDR0_DQ2";
DDRSS1.peripheral.DQ3.$suggestSolution                  = "DDR0_DQ3";
DDRSS1.peripheral.DQ4.$suggestSolution                  = "DDR0_DQ4";
DDRSS1.peripheral.DQ5.$suggestSolution                  = "DDR0_DQ5";
DDRSS1.peripheral.DQ6.$suggestSolution                  = "DDR0_DQ6";
DDRSS1.peripheral.DQ7.$suggestSolution                  = "DDR0_DQ7";
DDRSS1.peripheral.DQ8.$suggestSolution                  = "DDR0_DQ8";
DDRSS1.peripheral.DQ9.$suggestSolution                  = "DDR0_DQ9";
DDRSS1.peripheral.DQS0.$suggestSolution                 = "DDR0_DQS0";
DDRSS1.peripheral.DQS0_n.$suggestSolution               = "DDR0_DQS0_n";
DDRSS1.peripheral.DQS1.$suggestSolution                 = "DDR0_DQS1";
DDRSS1.peripheral.DQS1_n.$suggestSolution               = "DDR0_DQS1_n";
DDRSS1.peripheral.ODT0.$suggestSolution                 = "DDR0_ODT0";
DDRSS1.peripheral.ODT1.$suggestSolution                 = "DDR0_ODT1";
DDRSS1.peripheral.PAR.$suggestSolution                  = "DDR0_PAR";
DDRSS1.peripheral.RAS_n.$suggestSolution                = "DDR0_RAS_n";
DDRSS1.peripheral.RESET0_n.$suggestSolution             = "DDR0_RESET0_n";
DDRSS1.peripheral.WE_n.$suggestSolution                 = "DDR0_WE_n";
DDRSS1.peripheral.CAL0.$suggestSolution                 = "DDR0_CAL0";
DSS1.peripheral.VSYNC.$suggestSolution                  = "VOUT0_VSYNC";
DSS1.peripheral.HSYNC.$suggestSolution                  = "VOUT0_HSYNC";
DSS1.peripheral.PCLK.$suggestSolution                   = "VOUT0_PCLK";
DSS1.peripheral.DE.$suggestSolution                     = "VOUT0_DE";
DSS1.peripheral.DATA0.$suggestSolution                  = "VOUT0_DATA0";
DSS1.peripheral.DATA1.$suggestSolution                  = "VOUT0_DATA1";
DSS1.peripheral.DATA2.$suggestSolution                  = "VOUT0_DATA2";
DSS1.peripheral.DATA3.$suggestSolution                  = "VOUT0_DATA3";
DSS1.peripheral.DATA4.$suggestSolution                  = "VOUT0_DATA4";
DSS1.peripheral.DATA5.$suggestSolution                  = "VOUT0_DATA5";
DSS1.peripheral.DATA6.$suggestSolution                  = "VOUT0_DATA6";
DSS1.peripheral.DATA7.$suggestSolution                  = "VOUT0_DATA7";
DSS1.peripheral.DATA8.$suggestSolution                  = "VOUT0_DATA8";
DSS1.peripheral.DATA9.$suggestSolution                  = "VOUT0_DATA9";
DSS1.peripheral.DATA10.$suggestSolution                 = "VOUT0_DATA10";
DSS1.peripheral.DATA11.$suggestSolution                 = "VOUT0_DATA11";
DSS1.peripheral.DATA12.$suggestSolution                 = "VOUT0_DATA12";
DSS1.peripheral.DATA13.$suggestSolution                 = "VOUT0_DATA13";
DSS1.peripheral.DATA14.$suggestSolution                 = "VOUT0_DATA14";
DSS1.peripheral.DATA15.$suggestSolution                 = "VOUT0_DATA15";
DSS1.peripheral.DATA16.$suggestSolution                 = "GPMC0_AD8";
DSS1.peripheral.DATA17.$suggestSolution                 = "GPMC0_AD9";
DSS1.peripheral.DATA18.$suggestSolution                 = "GPMC0_AD10";
DSS1.peripheral.DATA19.$suggestSolution                 = "GPMC0_AD11";
DSS1.peripheral.DATA20.$suggestSolution                 = "GPMC0_AD12";
DSS1.peripheral.DATA21.$suggestSolution                 = "GPMC0_AD13";
DSS1.peripheral.DATA22.$suggestSolution                 = "GPMC0_AD14";
DSS1.peripheral.DATA23.$suggestSolution                 = "GPMC0_AD15";
EPWM1.peripheral.$suggestSolution                       = "EHRPWM0";
EPWM1.peripheral.A.$suggestSolution                     = "SPI0_CS0";
GPIO1.associatedPins[1].GPIO.$suggestSolution           = "OSPI0_D7";
GPIO1.associatedPins[2].GPIO.$suggestSolution           = "GPMC0_AD0";
GPIO1.associatedPins[3].GPIO.$suggestSolution           = "GPMC0_AD1";
GPIO1.associatedPins[4].GPIO.$suggestSolution           = "GPMC0_AD2";
GPIO1.associatedPins[7].GPIO.$suggestSolution           = "GPMC0_AD3";
GPIO1.associatedPins[9].GPIO.$suggestSolution           = "GPMC0_AD4";
GPIO1.associatedPins[10].GPIO.$suggestSolution          = "GPMC0_AD5";
GPIO2.associatedPins[7].GPIO.$suggestSolution           = "GPMC0_AD6";
GPIO2.associatedPins[12].GPIO.$suggestSolution          = "GPMC0_AD7";
GPIO2.associatedPins[13].GPIO.$suggestSolution          = "GPMC0_CLK";
GPIO2.associatedPins[14].GPIO.$suggestSolution          = "GPMC0_ADVn_ALE";
GPIO2.associatedPins[16].GPIO.$suggestSolution          = "GPMC0_OEn_REn";
GPIO2.associatedPins[17].GPIO.$suggestSolution          = "GPMC0_WEn";
GPIO2.associatedPins[18].GPIO.$suggestSolution          = "GPMC0_BE0n_CLE";
GPIO2.associatedPins[19].GPIO.$suggestSolution          = "GPMC0_BE1n";
GPIO2.associatedPins[20].GPIO.$suggestSolution          = "GPMC0_WAIT0";
GPIO2.associatedPins[21].GPIO.$suggestSolution          = "GPMC0_DIR";
GPIO2.associatedPins[22].GPIO.$suggestSolution          = "GPMC0_CSn0";
GPIO2.associatedPins[23].GPIO.$suggestSolution          = "GPMC0_CSn1";
GPIO2.associatedPins[24].GPIO.$suggestSolution          = "RGMII2_TX_CTL";
GPIO2.associatedPins[25].GPIO.$suggestSolution          = "RGMII2_TXC";
GPIO2.associatedPins[26].GPIO.$suggestSolution          = "RGMII2_TD1";
GPIO2.associatedPins[27].GPIO.$suggestSolution          = "RGMII2_TD2";
GPIO2.associatedPins[28].GPIO.$suggestSolution          = "RGMII2_RX_CTL";
GPIO2.associatedPins[29].GPIO.$suggestSolution          = "RGMII2_RXC";
GPIO2.associatedPins[30].GPIO.$suggestSolution          = "RGMII2_RD0";
GPIO2.associatedPins[31].GPIO.$suggestSolution          = "RGMII2_RD1";
GPIO2.associatedPins[32].GPIO.$suggestSolution          = "SPI0_CS1";
GPIO2.associatedPins[33].GPIO.$suggestSolution          = "SPI0_D0";
GPIO2.associatedPins[34].GPIO.$suggestSolution          = "SPI0_D1";
GPIO2.associatedPins[35].GPIO.$suggestSolution          = "MCAN0_TX";
GPIO2.associatedPins[36].GPIO.$suggestSolution          = "MCAN0_RX";
I2C1.peripheral.SCL.$suggestSolution                    = "I2C0_SCL";
I2C1.peripheral.SDA.$suggestSolution                    = "I2C0_SDA";
I2C2.peripheral.SCL.$suggestSolution                    = "UART0_CTSn";
I2C2.peripheral.SDA.$suggestSolution                    = "UART0_RTSn";
I2C3.peripheral.$suggestSolution                        = "I2C2";
I2C3.peripheral.SCL.$suggestSolution                    = "GPMC0_CSn2";
I2C3.peripheral.SDA.$suggestSolution                    = "GPMC0_CSn3";
JTAG1.peripheral.EMU0.$suggestSolution                  = "EMU0";
JTAG1.peripheral.EMU1.$suggestSolution                  = "EMU1";
JTAG1.peripheral.TCK.$suggestSolution                   = "TCK";
JTAG1.peripheral.TDI.$suggestSolution                   = "TDI";
JTAG1.peripheral.TDO.$suggestSolution                   = "TDO";
JTAG1.peripheral.TMS.$suggestSolution                   = "TMS";
JTAG1.peripheral.TRSTn.$suggestSolution                 = "TRSTn";
MCASP1.peripheral.ACLKX.$suggestSolution                = "MCASP0_ACLKX";
MCASP1.peripheral.AFSX.$suggestSolution                 = "MCASP0_AFSX";
MCASP1.peripheral.ACLKR.$suggestSolution                = "MCASP0_ACLKR";
MCASP1.peripheral.AFSR.$suggestSolution                 = "MCASP0_AFSR";
MCASP1.peripheral.AXR0.$suggestSolution                 = "MCASP0_AXR1";
MCASP1.peripheral.AXR1.$suggestSolution                 = "MCASP0_AXR0";
MCU_I2C1.peripheral.$suggestSolution                    = "MCU_I2C0";
MCU_I2C1.peripheral.SCL.$suggestSolution                = "MCU_I2C0_SCL";
MCU_I2C1.peripheral.SDA.$suggestSolution                = "MCU_I2C0_SDA";
MCU_OSC1.peripheral.$suggestSolution                    = "MCU_OSC0";
MCU_OSC1.peripheral.XI.$suggestSolution                 = "MCU_OSC0_XI";
MCU_OSC1.peripheral.XO.$suggestSolution                 = "MCU_OSC0_XO";
MCU_SPI1.peripheral.$suggestSolution                    = "MCU_SPI0";
MCU_SPI1.peripheral.CLK.$suggestSolution                = "MCU_SPI0_CLK";
MCU_SPI1.peripheral.CS0.$suggestSolution                = "MCU_SPI0_CS0";
MCU_SPI1.peripheral.D0.$suggestSolution                 = "MCU_SPI0_D0";
MCU_SPI1.peripheral.D1.$suggestSolution                 = "MCU_SPI0_D1";
MCU_SYSTEM1.peripheral.$suggestSolution                 = "MCU_SYSTEM0";
MCU_SYSTEM1.peripheral.MCU_ERRORn.$suggestSolution      = "MCU_ERRORn";
MCU_SYSTEM1.peripheral.MCU_EXT_REFCLK0.$suggestSolution = "MCU_MCAN1_TX";
MCU_SYSTEM1.peripheral.MCU_PORz.$suggestSolution        = "MCU_PORz";
MCU_SYSTEM1.peripheral.MCU_RESETSTATz.$suggestSolution  = "MCU_RESETSTATz";
MCU_SYSTEM1.peripheral.MCU_RESETz.$suggestSolution      = "MCU_RESETz";
MCU_UART1.peripheral.$suggestSolution                   = "MCU_USART0";
MCU_UART1.peripheral.CTSn.$suggestSolution              = "MCU_UART0_CTSn";
MCU_UART1.peripheral.RTSn.$suggestSolution              = "MCU_UART0_RTSn";
MCU_UART1.peripheral.RXD.$suggestSolution               = "MCU_UART0_RXD";
MCU_UART1.peripheral.TXD.$suggestSolution               = "MCU_UART0_TXD";
MDIO1.peripheral.MDC.$suggestSolution                   = "MDIO0_MDC";
MDIO1.peripheral.MDIO.$suggestSolution                  = "MDIO0_MDIO";
MMC01.peripheral.CLK.$suggestSolution                   = "MMC0_CLK";
MMC01.peripheral.CMD.$suggestSolution                   = "MMC0_CMD";
MMC01.peripheral.DAT0.$suggestSolution                  = "MMC0_DAT0";
MMC01.peripheral.DAT1.$suggestSolution                  = "MMC0_DAT1";
MMC01.peripheral.DAT2.$suggestSolution                  = "MMC0_DAT2";
MMC01.peripheral.DAT3.$suggestSolution                  = "MMC0_DAT3";
MMC01.peripheral.DAT4.$suggestSolution                  = "MMC0_DAT4";
MMC01.peripheral.DAT5.$suggestSolution                  = "MMC0_DAT5";
MMC01.peripheral.DAT6.$suggestSolution                  = "MMC0_DAT6";
MMC01.peripheral.DAT7.$suggestSolution                  = "MMC0_DAT7";
MMC21.peripheral.CLK.$suggestSolution                   = "MMC2_CLK";
MMC21.peripheral.CMD.$suggestSolution                   = "MMC2_CMD";
MMC21.peripheral.DAT0.$suggestSolution                  = "MMC2_DAT0";
MMC21.peripheral.DAT1.$suggestSolution                  = "MMC2_DAT1";
MMC21.peripheral.DAT2.$suggestSolution                  = "MMC2_DAT2";
MMC21.peripheral.DAT3.$suggestSolution                  = "MMC2_DAT3";
MMC21.peripheral.SDCD.$suggestSolution                  = "MMC2_SDCD";
MMC21.peripheral.SDWP.$suggestSolution                  = "MMC2_SDWP";
RGMII1.peripheral.RD0.$suggestSolution                  = "RGMII1_RD0";
RGMII1.peripheral.RD1.$suggestSolution                  = "RGMII1_RD1";
RGMII1.peripheral.RD2.$suggestSolution                  = "RGMII1_RD2";
RGMII1.peripheral.RD3.$suggestSolution                  = "RGMII1_RD3";
RGMII1.peripheral.RXC.$suggestSolution                  = "RGMII1_RXC";
RGMII1.peripheral.RX_CTL.$suggestSolution               = "RGMII1_RX_CTL";
RGMII1.peripheral.TD0.$suggestSolution                  = "RGMII1_TD0";
RGMII1.peripheral.TD1.$suggestSolution                  = "RGMII1_TD1";
RGMII1.peripheral.TD2.$suggestSolution                  = "RGMII1_TD2";
RGMII1.peripheral.TD3.$suggestSolution                  = "RGMII1_TD3";
RGMII1.peripheral.TXC.$suggestSolution                  = "RGMII1_TXC";
RGMII1.peripheral.TX_CTL.$suggestSolution               = "RGMII1_TX_CTL";
SPI1.peripheral.CLK.$suggestSolution                    = "OSPI0_D5";
SPI1.peripheral.CS0.$suggestSolution                    = "OSPI0_D4";
SPI1.peripheral.D0.$suggestSolution                     = "OSPI0_D6";
SYSTEM1.peripheral.EXTINTn.$suggestSolution             = "EXTINTn";
SYSTEM1.peripheral.EXT_REFCLK1.$suggestSolution         = "EXT_REFCLK1";
SYSTEM1.peripheral.PORz_OUT.$suggestSolution            = "PORz_OUT";
SYSTEM1.peripheral.RESETSTATz.$suggestSolution          = "RESETSTATz";
SYSTEM1.peripheral.RESET_REQz.$suggestSolution          = "RESET_REQz";
UART1.peripheral.CTSn.$suggestSolution                  = "MCASP0_AXR3";
UART1.peripheral.RTSn.$suggestSolution                  = "MCASP0_AXR2";
UART1.peripheral.RXD.$suggestSolution                   = "I2C1_SCL";
UART1.peripheral.TXD.$suggestSolution                   = "I2C1_SDA";
UART2.peripheral.TXD.$suggestSolution                   = "GPMC0_WPn";
USB1.peripheral.DM.$suggestSolution                     = "USB0_DM";
USB1.peripheral.DP.$suggestSolution                     = "USB0_DP";
USB1.peripheral.DRVVBUS.$suggestSolution                = "USB0_DRVVBUS";
USB1.peripheral.RCALIB.$suggestSolution                 = "USB0_RCALIB";
USB1.peripheral.VBUS.$suggestSolution                   = "USB0_VBUS";
USB2.peripheral.$suggestSolution                        = "USB1";
USB2.peripheral.DM.$suggestSolution                     = "USB1_DM";
USB2.peripheral.DP.$suggestSolution                     = "USB1_DP";
USB2.peripheral.DRVVBUS.$suggestSolution                = "USB1_DRVVBUS";
USB2.peripheral.RCALIB.$suggestSolution                 = "USB1_RCALIB";
USB2.peripheral.VBUS.$suggestSolution                   = "USB1_VBUS";
WKUP_LFOSC1.peripheral.$suggestSolution                 = "WKUP_LFOSC0";
WKUP_LFOSC1.peripheral.XI.$suggestSolution              = "WKUP_LFOSC0_XI";
WKUP_LFOSC1.peripheral.XO.$suggestSolution              = "WKUP_LFOSC0_XO";
WKUP_SYSTEM1.peripheral.$suggestSolution                = "WKUP_SYSTEM";
WKUP_SYSTEM1.peripheral.PMIC_LPM_EN0.$suggestSolution   = "PMIC_LPM_EN0";
