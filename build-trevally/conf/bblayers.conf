## build-trevally/conf/bblayers.conf
```bitbake
# POKY_BBLAYERS_CONF_VERSION is increased each time build/conf/bblayers.conf
# changes incompatibly
POKY_BBLAYERS_CONF_VERSION = "2"

BBPATH = "${TOPDIR}"
BBFILES ?= ""

BBLAYERS ?= " \
  ${TOPDIR}/../poky/meta \
  ${TOPDIR}/../poky/meta-poky \
  ${TOPDIR}/../poky/meta-yocto-bsp \
  ${TOPDIR}/../meta-openembedded/meta-oe \
  ${TOPDIR}/../meta-openembedded/meta-multimedia \
  ${TOPDIR}/../meta-openembedded/meta-python \
  ${TOPDIR}/../meta-openembedded/meta-perl \
  ${TOPDIR}/../meta-openembedded/meta-networking \
  ${TOPDIR}/../meta-arm/meta-arm-toolchain \
  ${TOPDIR}/../meta-arm/meta-arm \
  ${TOPDIR}/../meta-ti/meta-ti-bsp \
  ${TOPDIR}/../meta-ti/meta-ti-extras \
  ${TOPDIR}/../meta-ti/meta-beagle \
  ${TOPDIR}/../meta-lea \
  ${TOPDIR}/../meta-lea-trevally \
  "
# home/wap/LEA/yocto-scarthgap/build-trevally/workspace 
```
