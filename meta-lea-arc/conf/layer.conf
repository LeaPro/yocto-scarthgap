## meta-lea-arc/conf/layer.conf
```bitbake
# We have a conf and classes directory, add to BBPATH
BBPATH .= ":${LAYERDIR}"

# We have recipes-* directories, add to BBFILES
BBFILES += "${LAYERDIR}/recipes-*/*/*.bb \
            ${LAYERDIR}/recipes-*/*/*.bbappend"

BBFILE_COLLECTIONS += "meta-lea-arc"
BBFILE_PATTERN_meta-lea-arc = "^${LAYERDIR}/"
BBFILE_PRIORITY_meta-lea-arc = "1"

LAYER_VERSION_meta-lea-arc = "1"
LAYERSERIES_COMPAT_meta-lea-arc = "scarthgap"
```

## meta-lea-dls/conf/layer.conf
```bitbake
# We have a conf and classes directory, add to BBPATH
BBPATH .= ":${LAYERDIR}"

# We have recipes-* directories, add to BBFILES
BBFILES += "${LAYERDIR}/recipes-*/*/*.bb \
            ${LAYERDIR}/recipes-*/*/*.bbappend"

BBFILE_COLLECTIONS += "meta-lea-dls"
BBFILE_PATTERN_meta-lea-dls = "^${LAYERDIR}/"
BBFILE_PRIORITY_meta-lea-dls = "1"

LAYER_VERSION_meta-lea-dls = "1"
LAYERSERIES_COMPAT_meta-lea-dls = "scarthgap"
```

## meta-lea-supershark/conf/layer.conf
```bitbake
# We have a conf and classes directory, add to BBPATH
BBPATH .= ":${LAYERDIR}"

# We have recipes-* directories, add to BBFILES
BBFILES += "${LAYERDIR}/recipes-*/*/*.bb \
            ${LAYERDIR}/recipes-*/*/*.bbappend"

BBFILE_COLLECTIONS += "meta-lea-supershark"
BBFILE_PATTERN_meta-lea-supershark = "^${LAYERDIR}/"
BBFILE_PRIORITY_meta-lea-supershark = "1"

LAYER_VERSION_meta-lea-supershark = "1"
LAYERSERIES_COMPAT_meta-lea-supershark = "scarthgap"
```

## meta-lea/conf/distro/lea.conf
```bitbake
include ../../../poky/meta/conf/distro/include/default-providers.inc
include ../../../poky/meta/conf/distro/include/default-versions.inc
include ../../../poky/meta/conf/distro/include/default-distrovars.inc
include ../../../poky/meta/conf/distro/include/maintainers.inc

require ../../../poky/meta/conf/distro/include/tcmode-${TCMODE}.inc
require ../../../poky/meta/conf/distro/include/tclibc-${TCLIBC}.inc

require ../../../poky/meta/conf/distro/include/uninative-flags.inc

DISTRO_NAME = "LEA (Yocto Project/OpenEmbedded Distro)"
DISTRO_VERSION = "1.1"

TCLIBCAPPEND = ""

USER_CLASSES ?= ""
PACKAGE_CLASSES ?= "package_ipk"
INHERIT_DISTRO ?= "debian devshell sstate license remove-libtool"
INHERIT += "${PACKAGE_CLASSES} ${USER_CLASSES} ${INHERIT_DISTRO}"

INIT_MANAGER = "systemd"
require ../../../poky/meta/conf/distro/include/init-manager-${INIT_MANAGER}.inc
```

## meta-lea/conf/layer.conf
```bitbake
# We have a conf and classes directory, add to BBPATH
BBPATH .= ":${LAYERDIR}"

# We have recipes-* directories, add to BBFILES
BBFILES += "${LAYERDIR}/recipes-*/*/*.bb \
            ${LAYERDIR}/recipes-*/*/*.bbappend"

BBFILE_COLLECTIONS += "meta-lea"
BBFILE_PATTERN_meta-lea = "^${LAYERDIR}/"
BBFILE_PRIORITY_meta-lea = "1"

LAYERDEPENDS_meta-lea = "core"
LAYERSERIES_COMPAT_meta-lea = "scarthgap"
```
